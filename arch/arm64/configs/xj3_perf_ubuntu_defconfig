## drivers/staging/rtl8812bu/Kconfig
```kconfig
config RTL8812BU
	tristate "Realtek 8812B USB WiFi"
	depends on USB
	---help---
	  Help message of RTL8812BU
```

## drivers/staging/rtl88x2cu/Kconfig
```kconfig
config RTL88x2CU
	tristate "Realtek 8822C USB WiFi"
	depends on USB
	---help---
	  Help message of RTL8822CU
```
